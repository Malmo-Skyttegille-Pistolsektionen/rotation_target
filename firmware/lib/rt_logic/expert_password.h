// ============================================================================
//  rt_logic/expert_password.h
//  The device's own Expert Mode password: how it is made, and how a session
//  proving it is held. Host-testable, no NVS and no ESP-IDF.
// ============================================================================
#pragma once

#include <cstddef>
#include <cstdint>
#include <deque>
#include <string>

#include "admin_mode.h"

namespace rt {

// Expert Mode guards the hardware configuration (#144): the target pin, the
// polarity, the peripheral pins, the hostname. Getting those wrong makes a
// device stop working, and the way back is a USB cable.
//
// It is a *separate* secret from admin mode, and the difference is the point:
//
//   - Admin mode is chosen by whoever turns it on, lives in RAM, and is gone
//     after a reboot. It protects the day-to-day - starting a run, deleting a
//     program - on a device where the club may not want a password at all.
//   - This is generated by the device, persists, and is never chosen by a
//     human. It protects the settings that survive a reboot and can strand the
//     device.
//
// It is handed over once, on the setup portal's completion page, and read back
// over serial. It is deliberately never shown in the web app: showing the
// password that gates a page, on that page, gates nothing.

// Four groups of four. Long enough that guessing is not the attack (the
// realistic one is somebody reading it over a shoulder), short enough to be
// read off a screen and typed into a phone at a range.
constexpr size_t kExpertPasswordGroups = 4;
constexpr size_t kExpertPasswordGroupLen = 4;
// Groups plus the separating hyphens.
constexpr size_t kExpertPasswordLength =
    kExpertPasswordGroups * kExpertPasswordGroupLen + (kExpertPasswordGroups - 1);

// No 0/O, 1/l/I, 5/S, 2/Z, 8/B. Somebody is transcribing this from a screen,
// possibly outdoors, and a password that cannot be read back is worse than a
// shorter one: it sends them for a cable.
//
// 30 symbols over 16 characters is ~78 bits, which is far more than the threat
// needs and costs nothing.
inline constexpr const char kExpertPasswordAlphabet[] = "acdefghjkmnpqrtuvwxy34679";

// Builds a password from `random_bytes`, in the shape above.
//
// The bytes are consumed one per character and folded into the alphabet with a
// modulo. That is very slightly biased - 256 is not a multiple of the alphabet
// size - and deliberately accepted: at this length the bias is far below what
// any attacker could use, and rejection sampling would make the function
// consume a variable number of bytes, which is harder to test and to reason
// about than the bias it removes.
std::string make_expert_password(RandomBytesFn random_bytes);

// Whether a string is shaped like one of ours. Used to reject a stored value
// that has been corrupted or written by hand, so the device regenerates rather
// than carrying a password nobody can type.
bool is_well_formed_expert_password(const std::string &password);

// Sessions proving the Expert password, mirroring AdminMode's token handling.
//
// Separate from AdminMode rather than folded into it: the two protect different
// things and are unlocked by different secrets, so a client holding one must
// not be able to use it as the other.
class ExpertSession {
 public:
  ExpertSession(RandomBytesFn random_bytes, NowMsFn now_ms)
      : random_bytes_(random_bytes), now_ms_(now_ms) {}

  // The device's current password. Set once at boot from storage.
  void set_password(const std::string &password) { password_ = password; }

  // A session token for the right password, or empty. Unlike admin mode there
  // is no "off" state: the hardware configuration is always protected, because
  // the password always exists.
  std::string unlock(const std::string &password) {
    if (password_.empty() || !constant_time_equals(password, password_)) return {};
    return issue_token();
  }

  bool authorize(const std::string &authorization_header) const {
    return is_valid_token(AdminMode::bearer_token(authorization_header));
  }

  bool logout(const std::string &token) {
    for (auto it = tokens_.begin(); it != tokens_.end(); ++it) {
      if (constant_time_equals(it->value, token)) {
        tokens_.erase(it);
        return true;
      }
    }
    return false;
  }

  // Rotating the password invalidates every session: whoever rotated it did so
  // because the old one should stop working, and a token minted from it is the
  // old one.
  void rotate_to(const std::string &password) {
    password_ = password;
    tokens_.clear();
  }

 private:
  struct Token {
    std::string value;
    int64_t issued_ms = 0;
  };

  std::string issue_token() {
    uint8_t raw[kTokenBytes];
    random_bytes_(raw, kTokenBytes);

    static const char *hex = "0123456789abcdef";
    std::string token;
    token.reserve(kTokenBytes * 2);
    for (const uint8_t byte : raw) {
      token.push_back(hex[byte >> 4]);
      token.push_back(hex[byte & 0x0f]);
    }

    if (tokens_.size() >= kMaxTokens) tokens_.pop_front();
    tokens_.push_back({token, now_ms_()});
    return token;
  }

  bool is_valid_token(const std::string &token) const {
    if (token.empty()) return false;
    const int64_t now = now_ms_();
    for (const Token &held : tokens_) {
      if (now - held.issued_ms > kTokenTtlMs) continue;
      if (constant_time_equals(held.value, token)) return true;
    }
    return false;
  }

  RandomBytesFn random_bytes_;
  NowMsFn now_ms_;
  std::string password_;
  std::deque<Token> tokens_;
};

}  // namespace rt
